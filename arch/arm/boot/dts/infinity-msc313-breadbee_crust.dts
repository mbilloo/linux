// SPDX-License-Identifier: GPL-2.0
/*
 * Copyright (c) 2019 thingy.jp.
 * Author: Daniel Palmer <daniel@thingy.jp>
 */

/dts-v1/;
#include "infinity-msc313.dtsi"
#include "infinity-breadbee-common.dtsi"

/ {
	model = "thingy.jp breadbee";
	compatible = "thingyjp,breadbee_crust", "mstar,infinity";
};
