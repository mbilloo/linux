// SPDX-License-Identifier: GPL-2.0
/*
 * Copyright (c) 2019 thingy.jp.
 * Author: Daniel Palmer <daniel@thingy.jp>
 */

#include "chenxing-v7.dtsi"

/ {
};

&soc {
};

&sram {
	reg = <0xa0000000 0x20000>;
};
