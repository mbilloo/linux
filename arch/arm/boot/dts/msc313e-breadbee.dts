// SPDX-License-Identifier: GPL-2.0
/*
 * Copyright (c) 2019 thingy.jp.
 * Author: Daniel Palmer <daniel@thingy.jp>
 */

/dts-v1/;
#include "msc313e.dtsi"

/ {
	model = "thingy.jp breadbee";
	compatible = "thingyjp,breadbee", "mstar,msc313e", "mstar,msc313";

	chosen {
		stdout-path = "serial0:115200n8";
		bootargs = "console=ttyS0,115200";
	};

	aliases {
		console = &pm_uart;
	};
};

&pm_uart {
	status = "okay";
};
