// SPDX-License-Identifier: GPL-2.0
/*
 * Copyright (c) 2019 thingy.jp.
 * Author: Daniel Palmer <daniel@thingy.jp>
 */

#include "mercury5.dtsi"

/ {
};

&pinctrl {
	compatible = "mstar,ssc8336n-pinctrl";
};

&gpio {
	compatible = "mstar,ssc8336-gpio";
	status = "okay";
};

&gpio_pm {
	compatible = "mstar,ssc8336-gpio-pm";
	gpio-ranges = <&pinctrl 0 30 1>, <&pinctrl 1 43 1>;
	interrupt-names = "pm_spi_do", "pm_sd_sdz";
	interrupts-extended = <&gpio_pm 0 29 IRQ_TYPE_LEVEL_HIGH>,
			      <&intc_irq 24 IRQ_TYPE_LEVEL_HIGH>;
	/* <&intc_fiq 23 IRQ_TYPE_LEVEL_HIGH>; */
	status = "okay";
};

&sar {
	compatible = "mstar,ssc8336-sar";
};
