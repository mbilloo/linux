// SPDX-License-Identifier: GPL-2.0
/*
 * Copyright (c) 2019 thingy.jp.
 * Author: Daniel Palmer <daniel@0x0f.com>
 *
 */

#include "msc313.dtsi"

/ {
	compatible = "mstar,msc313", "mstar,msc313d";

	memory {
		device_type = "memory";
		reg = <0x20000000 0x8000000>;
	};
};
