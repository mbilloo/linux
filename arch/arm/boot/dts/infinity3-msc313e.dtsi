// SPDX-License-Identifier: GPL-2.0
/*
 * Copyright (c) 2019 thingy.jp.
 * Author: Daniel Palmer <daniel@thingy.jp>
 */

#include "infinity3.dtsi"

/ {
	memory {
		device_type = "memory";
		reg = <0x20000000 0x4000000>;
	};
};
