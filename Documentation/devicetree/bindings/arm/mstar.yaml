## Documentation/devicetree/bindings/arm/mstar.yaml
```yaml
# SPDX-License-Identifier: (GPL-2.0-only OR BSD-2-Clause)
%YAML 1.2
---
$id: http://devicetree.org/schemas/arm/mstar.yaml#
$schema: http://devicetree.org/meta-schemas/core.yaml#

title: MStar platforms device tree bindings

maintainers:
  - Daniel Palmer <daniel@thingy.jp>

properties:
  $nodename:
    const: '/'
  compatible:
    oneOf:
        # infinity boards
        - items:
          - enum:
              - thingyjp,breadbee-crust # thingy.jp BreadBee Crust
              - thingyjp,breadbee-crustx # thingy.jp BreadBee Crustx
          - const: mstar,infinity

        # infinity3 boards
        - items:
          - enum:
              - thingyjp,breadbee # thingy.jp BreadBee
          - const: mstar,infinity3

        # mercury5 boards
        - items:
          - enum:
              - 70mai,midrived08 # 70mai midrive d08
          - const: mstar,mercury5
```

## arch/arm/configs/breadbee_defconfig
```kconfig
CONFIG_ARCH_MSTARV7=y

CONFIG_KERNEL_XZ=y
CONFIG_POSIX_MQUEUE=y
CONFIG_POSIX_MQUEUE_SYSCTL=y
CONFIG_CROSS_MEMORY_ATTACH=y
CONFIG_HAVE_ARCH_AUDITSYSCALL=y
CONFIG_GENERIC_IRQ_EFFECTIVE_AFF_MASK=y
CONFIG_GENERIC_IRQ_INJECTION=y
CONFIG_IRQ_DOMAIN_HIERARCHY=y
CONFIG_GENERIC_IRQ_DEBUGFS=y
CONFIG_GENERIC_TIME_VSYSCALL=y

CONFIG_TICK_ONESHOT=y
CONFIG_HIGH_RES_TIMERS=y

CONFIG_IKCONFIG=y
CONFIG_IKCONFIG_PROC=y

CONFIG_CGROUPS=y
CONFIG_CGROUP_SCHED=y
CONFIG_FAIR_GROUP_SCHED=y

CONFIG_NAMESPACES=y
# CONFIG_UTS_NS is not set
CONFIG_IPC_NS=y
# CONFIG_USER_NS is not set
# CONFIG_PID_NS is not set
CONFIG_SCHED_AUTOGROUP=y
CONFIG_BLK_DEV_INITRD=y
CONFIG_INITRAMFS_SOURCE=""
# CONFIG_RD_GZIP is not set
# CONFIG_RD_BZIP2 is not set
# CONFIG_RD_LZMA is not set
CONFIG_RD_XZ=y
# CONFIG_RD_LZO is not set
# CONFIG_RD_LZ4 is not set

# CONFIG_CC_OPTIMIZE_FOR_PERFORMANCE is not set
CONFIG_CC_OPTIMIZE_FOR_SIZE=y

CONFIG_BPF=y


CONFIG_NET=y
CONFIG_MACB=y
CONFIG_MDIO_DEVICE=y
CONFIG_MDIO_BUS=y
CONFIG_PHYLINK=y
CONFIG_PHYLIB=y
CONFIG_SWPHY=y
CONFIG_FIXED_PHY=y
CONFIG_MSC313_PHY=y
CONFIG_USB_NET_DRIVERS=y
CONFIG_USB_USBNET=y
CONFIG_USB_NET_AX8817X=y
CONFIG_USB_NET_CDCETHER=y
CONFIG_WLAN=y
CONFIG_WLAN_VENDOR_REALTEK=y
CONFIG_RTL_CARDS=y
CONFIG_RTL8192CU=y
CONFIG_RTLWIFI=y
CONFIG_RTLWIFI_USB=y
CONFIG_RTLWIFI_DEBUG=y
CONFIG_RTL8192C_COMMON=y
CONFIG_INPUT=y
CONFIG_INPUT_LEDS=y
CONFIG_INPUT_POLLDEV=y
CONFIG_INPUT_KEYBOARD=y
CONFIG_KEYBOARD_GPIO=y
CONFIG_KEYBOARD_GPIO_POLLED=y
CONFIG_INPUT_TOUCHSCREEN=y
CONFIG_TOUCHSCREEN_PROPERTIES=y
CONFIG_TOUCHSCREEN_GOODIX=y
CONFIG_TTY=y
CONFIG_VT=y
CONFIG_CONSOLE_TRANSLATIONS=y
CONFIG_VT_CONSOLE=y
CONFIG_VT_CONSOLE_SLEEP=y
CONFIG_HW_CONSOLE=y
CONFIG_VT_HW_CONSOLE_BINDING=y
CONFIG_UNIX98_PTYS=y
CONFIG_LDISC_AUTOLOAD=y
CONFIG_DEVMEM=y
CONFIG_DEVKMEM=y
CONFIG_I2C_MSC313E=y
CONFIG_SPI_MSC313=y
CONFIG_GPIO_MSC313E=y
CONFIG_MSC313E_WATCHDOG=y
CONFIG_RTC_DRV_MSC313E=y
CONFIG_MSTAR_MSC313_BDMA=y
CONFIG_MSTAR_MSC313_CMDQ=y
CONFIG_MSC313E_TIMER=y
CONFIG_MSC313E_SAR=y
CONFIG_PWM_MSC313=y
CONFIG_PWM_MSC313E=y
```

## arch/arm/mach-mstar/Kconfig
```kconfig
menuconfig ARCH_MSTAR
	bool "MStar SoC Support"
	depends on ARCH_MULTI_V7
	select ARM_GIC
	select ARM_HEAVY_MB
	help
	  Support for MStar ARMv7 SoCs

if ARCH_MSTAR

config MACH_INFINITY
	bool "MStar infinity SoC support"
	default ARCH_INFINITY
	help
	  Support for MStar infinity(1/3) IP camera SoCs
endif
```
